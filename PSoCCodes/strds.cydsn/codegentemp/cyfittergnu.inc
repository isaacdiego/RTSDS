.ifndef INCLUDED_CYFITTERGNU_INC
.set INCLUDED_CYFITTERGNU_INC, 1
.include "cydevicegnu.inc"
.include "cydevicegnu_trm.inc"

/* PINO_PROCESSAMENTO */
.set PINO_PROCESSAMENTO__0__MASK, 0x01
.set PINO_PROCESSAMENTO__0__PC, CYREG_PRT0_PC0
.set PINO_PROCESSAMENTO__0__PORT, 0
.set PINO_PROCESSAMENTO__0__SHIFT, 0
.set PINO_PROCESSAMENTO__AG, CYREG_PRT0_AG
.set PINO_PROCESSAMENTO__AMUX, CYREG_PRT0_AMUX
.set PINO_PROCESSAMENTO__BIE, CYREG_PRT0_BIE
.set PINO_PROCESSAMENTO__BIT_MASK, CYREG_PRT0_BIT_MASK
.set PINO_PROCESSAMENTO__BYP, CYREG_PRT0_BYP
.set PINO_PROCESSAMENTO__CTL, CYREG_PRT0_CTL
.set PINO_PROCESSAMENTO__DM0, CYREG_PRT0_DM0
.set PINO_PROCESSAMENTO__DM1, CYREG_PRT0_DM1
.set PINO_PROCESSAMENTO__DM2, CYREG_PRT0_DM2
.set PINO_PROCESSAMENTO__DR, CYREG_PRT0_DR
.set PINO_PROCESSAMENTO__INP_DIS, CYREG_PRT0_INP_DIS
.set PINO_PROCESSAMENTO__LCD_COM_SEG, CYREG_PRT0_LCD_COM_SEG
.set PINO_PROCESSAMENTO__LCD_EN, CYREG_PRT0_LCD_EN
.set PINO_PROCESSAMENTO__MASK, 0x01
.set PINO_PROCESSAMENTO__PORT, 0
.set PINO_PROCESSAMENTO__PRT, CYREG_PRT0_PRT
.set PINO_PROCESSAMENTO__PRTDSI__CAPS_SEL, CYREG_PRT0_CAPS_SEL
.set PINO_PROCESSAMENTO__PRTDSI__DBL_SYNC_IN, CYREG_PRT0_DBL_SYNC_IN
.set PINO_PROCESSAMENTO__PRTDSI__OE_SEL0, CYREG_PRT0_OE_SEL0
.set PINO_PROCESSAMENTO__PRTDSI__OE_SEL1, CYREG_PRT0_OE_SEL1
.set PINO_PROCESSAMENTO__PRTDSI__OUT_SEL0, CYREG_PRT0_OUT_SEL0
.set PINO_PROCESSAMENTO__PRTDSI__OUT_SEL1, CYREG_PRT0_OUT_SEL1
.set PINO_PROCESSAMENTO__PRTDSI__SYNC_OUT, CYREG_PRT0_SYNC_OUT
.set PINO_PROCESSAMENTO__PS, CYREG_PRT0_PS
.set PINO_PROCESSAMENTO__SHIFT, 0
.set PINO_PROCESSAMENTO__SLW, CYREG_PRT0_SLW

/* MAD_1_ADC_SAR */
.set MAD_1_ADC_SAR__CLK, CYREG_SAR1_CLK
.set MAD_1_ADC_SAR__CSR0, CYREG_SAR1_CSR0
.set MAD_1_ADC_SAR__CSR1, CYREG_SAR1_CSR1
.set MAD_1_ADC_SAR__CSR2, CYREG_SAR1_CSR2
.set MAD_1_ADC_SAR__CSR3, CYREG_SAR1_CSR3
.set MAD_1_ADC_SAR__CSR4, CYREG_SAR1_CSR4
.set MAD_1_ADC_SAR__CSR5, CYREG_SAR1_CSR5
.set MAD_1_ADC_SAR__CSR6, CYREG_SAR1_CSR6
.set MAD_1_ADC_SAR__CSR7, CYREG_SAR1_CSR7
.set MAD_1_ADC_SAR__PM_ACT_CFG, CYREG_PM_ACT_CFG11
.set MAD_1_ADC_SAR__PM_ACT_MSK, 0x02
.set MAD_1_ADC_SAR__PM_STBY_CFG, CYREG_PM_STBY_CFG11
.set MAD_1_ADC_SAR__PM_STBY_MSK, 0x02
.set MAD_1_ADC_SAR__SW0, CYREG_SAR1_SW0
.set MAD_1_ADC_SAR__SW2, CYREG_SAR1_SW2
.set MAD_1_ADC_SAR__SW3, CYREG_SAR1_SW3
.set MAD_1_ADC_SAR__SW4, CYREG_SAR1_SW4
.set MAD_1_ADC_SAR__SW6, CYREG_SAR1_SW6
.set MAD_1_ADC_SAR__TR0, CYREG_SAR1_TR0
.set MAD_1_ADC_SAR__TRIM__TR0, CYREG_FLSHID_MFG_CFG_SAR1_TR0
.set MAD_1_ADC_SAR__TRIM__TR1, CYREG_FLSHID_MFG_CFG_SAR1_TR1
.set MAD_1_ADC_SAR__WRK0, CYREG_SAR1_WRK0
.set MAD_1_ADC_SAR__WRK1, CYREG_SAR1_WRK1

/* MAD_1_theACLK */
.set MAD_1_theACLK__CFG0, CYREG_CLKDIST_ACFG1_CFG0
.set MAD_1_theACLK__CFG1, CYREG_CLKDIST_ACFG1_CFG1
.set MAD_1_theACLK__CFG2, CYREG_CLKDIST_ACFG1_CFG2
.set MAD_1_theACLK__CFG2_SRC_SEL_MASK, 0x07
.set MAD_1_theACLK__CFG3, CYREG_CLKDIST_ACFG1_CFG3
.set MAD_1_theACLK__CFG3_PHASE_DLY_MASK, 0x0F
.set MAD_1_theACLK__INDEX, 0x01
.set MAD_1_theACLK__PM_ACT_CFG, CYREG_PM_ACT_CFG1
.set MAD_1_theACLK__PM_ACT_MSK, 0x02
.set MAD_1_theACLK__PM_STBY_CFG, CYREG_PM_STBY_CFG1
.set MAD_1_theACLK__PM_STBY_MSK, 0x02

/* MAD_2_ADC_SAR */
.set MAD_2_ADC_SAR__CLK, CYREG_SAR0_CLK
.set MAD_2_ADC_SAR__CSR0, CYREG_SAR0_CSR0
.set MAD_2_ADC_SAR__CSR1, CYREG_SAR0_CSR1
.set MAD_2_ADC_SAR__CSR2, CYREG_SAR0_CSR2
.set MAD_2_ADC_SAR__CSR3, CYREG_SAR0_CSR3
.set MAD_2_ADC_SAR__CSR4, CYREG_SAR0_CSR4
.set MAD_2_ADC_SAR__CSR5, CYREG_SAR0_CSR5
.set MAD_2_ADC_SAR__CSR6, CYREG_SAR0_CSR6
.set MAD_2_ADC_SAR__CSR7, CYREG_SAR0_CSR7
.set MAD_2_ADC_SAR__PM_ACT_CFG, CYREG_PM_ACT_CFG11
.set MAD_2_ADC_SAR__PM_ACT_MSK, 0x01
.set MAD_2_ADC_SAR__PM_STBY_CFG, CYREG_PM_STBY_CFG11
.set MAD_2_ADC_SAR__PM_STBY_MSK, 0x01
.set MAD_2_ADC_SAR__SW0, CYREG_SAR0_SW0
.set MAD_2_ADC_SAR__SW2, CYREG_SAR0_SW2
.set MAD_2_ADC_SAR__SW3, CYREG_SAR0_SW3
.set MAD_2_ADC_SAR__SW4, CYREG_SAR0_SW4
.set MAD_2_ADC_SAR__SW6, CYREG_SAR0_SW6
.set MAD_2_ADC_SAR__TR0, CYREG_SAR0_TR0
.set MAD_2_ADC_SAR__TRIM__TR0, CYREG_FLSHID_MFG_CFG_SAR0_TR0
.set MAD_2_ADC_SAR__TRIM__TR1, CYREG_FLSHID_MFG_CFG_SAR0_TR1
.set MAD_2_ADC_SAR__WRK0, CYREG_SAR0_WRK0
.set MAD_2_ADC_SAR__WRK1, CYREG_SAR0_WRK1

/* MAD_2_theACLK */
.set MAD_2_theACLK__CFG0, CYREG_CLKDIST_ACFG0_CFG0
.set MAD_2_theACLK__CFG1, CYREG_CLKDIST_ACFG0_CFG1
.set MAD_2_theACLK__CFG2, CYREG_CLKDIST_ACFG0_CFG2
.set MAD_2_theACLK__CFG2_SRC_SEL_MASK, 0x07
.set MAD_2_theACLK__CFG3, CYREG_CLKDIST_ACFG0_CFG3
.set MAD_2_theACLK__CFG3_PHASE_DLY_MASK, 0x0F
.set MAD_2_theACLK__INDEX, 0x00
.set MAD_2_theACLK__PM_ACT_CFG, CYREG_PM_ACT_CFG1
.set MAD_2_theACLK__PM_ACT_MSK, 0x01
.set MAD_2_theACLK__PM_STBY_CFG, CYREG_PM_STBY_CFG1
.set MAD_2_theACLK__PM_STBY_MSK, 0x01

/* Timer_TimerHW */
.set Timer_TimerHW__CAP0, CYREG_TMR0_CAP0
.set Timer_TimerHW__CAP1, CYREG_TMR0_CAP1
.set Timer_TimerHW__CFG0, CYREG_TMR0_CFG0
.set Timer_TimerHW__CFG1, CYREG_TMR0_CFG1
.set Timer_TimerHW__CNT_CMP0, CYREG_TMR0_CNT_CMP0
.set Timer_TimerHW__CNT_CMP1, CYREG_TMR0_CNT_CMP1
.set Timer_TimerHW__PER0, CYREG_TMR0_PER0
.set Timer_TimerHW__PER1, CYREG_TMR0_PER1
.set Timer_TimerHW__PM_ACT_CFG, CYREG_PM_ACT_CFG3
.set Timer_TimerHW__PM_ACT_MSK, 0x01
.set Timer_TimerHW__PM_STBY_CFG, CYREG_PM_STBY_CFG3
.set Timer_TimerHW__PM_STBY_MSK, 0x01
.set Timer_TimerHW__RT0, CYREG_TMR0_RT0
.set Timer_TimerHW__RT1, CYREG_TMR0_RT1
.set Timer_TimerHW__SR0, CYREG_TMR0_SR0

/* MAD_1_Bypass */
.set MAD_1_Bypass__0__MASK, 0x04
.set MAD_1_Bypass__0__PC, CYREG_PRT0_PC2
.set MAD_1_Bypass__0__PORT, 0
.set MAD_1_Bypass__0__SHIFT, 2
.set MAD_1_Bypass__AG, CYREG_PRT0_AG
.set MAD_1_Bypass__AMUX, CYREG_PRT0_AMUX
.set MAD_1_Bypass__BIE, CYREG_PRT0_BIE
.set MAD_1_Bypass__BIT_MASK, CYREG_PRT0_BIT_MASK
.set MAD_1_Bypass__BYP, CYREG_PRT0_BYP
.set MAD_1_Bypass__CTL, CYREG_PRT0_CTL
.set MAD_1_Bypass__DM0, CYREG_PRT0_DM0
.set MAD_1_Bypass__DM1, CYREG_PRT0_DM1
.set MAD_1_Bypass__DM2, CYREG_PRT0_DM2
.set MAD_1_Bypass__DR, CYREG_PRT0_DR
.set MAD_1_Bypass__INP_DIS, CYREG_PRT0_INP_DIS
.set MAD_1_Bypass__LCD_COM_SEG, CYREG_PRT0_LCD_COM_SEG
.set MAD_1_Bypass__LCD_EN, CYREG_PRT0_LCD_EN
.set MAD_1_Bypass__MASK, 0x04
.set MAD_1_Bypass__PORT, 0
.set MAD_1_Bypass__PRT, CYREG_PRT0_PRT
.set MAD_1_Bypass__PRTDSI__CAPS_SEL, CYREG_PRT0_CAPS_SEL
.set MAD_1_Bypass__PRTDSI__DBL_SYNC_IN, CYREG_PRT0_DBL_SYNC_IN
.set MAD_1_Bypass__PRTDSI__OE_SEL0, CYREG_PRT0_OE_SEL0
.set MAD_1_Bypass__PRTDSI__OE_SEL1, CYREG_PRT0_OE_SEL1
.set MAD_1_Bypass__PRTDSI__OUT_SEL0, CYREG_PRT0_OUT_SEL0
.set MAD_1_Bypass__PRTDSI__OUT_SEL1, CYREG_PRT0_OUT_SEL1
.set MAD_1_Bypass__PRTDSI__SYNC_OUT, CYREG_PRT0_SYNC_OUT
.set MAD_1_Bypass__PS, CYREG_PRT0_PS
.set MAD_1_Bypass__SHIFT, 2
.set MAD_1_Bypass__SLW, CYREG_PRT0_SLW

/* MAD_2_Bypass */
.set MAD_2_Bypass__0__MASK, 0x10
.set MAD_2_Bypass__0__PC, CYREG_PRT0_PC4
.set MAD_2_Bypass__0__PORT, 0
.set MAD_2_Bypass__0__SHIFT, 4
.set MAD_2_Bypass__AG, CYREG_PRT0_AG
.set MAD_2_Bypass__AMUX, CYREG_PRT0_AMUX
.set MAD_2_Bypass__BIE, CYREG_PRT0_BIE
.set MAD_2_Bypass__BIT_MASK, CYREG_PRT0_BIT_MASK
.set MAD_2_Bypass__BYP, CYREG_PRT0_BYP
.set MAD_2_Bypass__CTL, CYREG_PRT0_CTL
.set MAD_2_Bypass__DM0, CYREG_PRT0_DM0
.set MAD_2_Bypass__DM1, CYREG_PRT0_DM1
.set MAD_2_Bypass__DM2, CYREG_PRT0_DM2
.set MAD_2_Bypass__DR, CYREG_PRT0_DR
.set MAD_2_Bypass__INP_DIS, CYREG_PRT0_INP_DIS
.set MAD_2_Bypass__LCD_COM_SEG, CYREG_PRT0_LCD_COM_SEG
.set MAD_2_Bypass__LCD_EN, CYREG_PRT0_LCD_EN
.set MAD_2_Bypass__MASK, 0x10
.set MAD_2_Bypass__PORT, 0
.set MAD_2_Bypass__PRT, CYREG_PRT0_PRT
.set MAD_2_Bypass__PRTDSI__CAPS_SEL, CYREG_PRT0_CAPS_SEL
.set MAD_2_Bypass__PRTDSI__DBL_SYNC_IN, CYREG_PRT0_DBL_SYNC_IN
.set MAD_2_Bypass__PRTDSI__OE_SEL0, CYREG_PRT0_OE_SEL0
.set MAD_2_Bypass__PRTDSI__OE_SEL1, CYREG_PRT0_OE_SEL1
.set MAD_2_Bypass__PRTDSI__OUT_SEL0, CYREG_PRT0_OUT_SEL0
.set MAD_2_Bypass__PRTDSI__OUT_SEL1, CYREG_PRT0_OUT_SEL1
.set MAD_2_Bypass__PRTDSI__SYNC_OUT, CYREG_PRT0_SYNC_OUT
.set MAD_2_Bypass__PS, CYREG_PRT0_PS
.set MAD_2_Bypass__SHIFT, 4
.set MAD_2_Bypass__SLW, CYREG_PRT0_SLW

/* MSG_1_viDAC8 */
.set MSG_1_viDAC8__CR0, CYREG_DAC1_CR0
.set MSG_1_viDAC8__CR1, CYREG_DAC1_CR1
.set MSG_1_viDAC8__D, CYREG_DAC1_D
.set MSG_1_viDAC8__PM_ACT_CFG, CYREG_PM_ACT_CFG8
.set MSG_1_viDAC8__PM_ACT_MSK, 0x02
.set MSG_1_viDAC8__PM_STBY_CFG, CYREG_PM_STBY_CFG8
.set MSG_1_viDAC8__PM_STBY_MSK, 0x02
.set MSG_1_viDAC8__STROBE, CYREG_DAC1_STROBE
.set MSG_1_viDAC8__SW0, CYREG_DAC1_SW0
.set MSG_1_viDAC8__SW2, CYREG_DAC1_SW2
.set MSG_1_viDAC8__SW3, CYREG_DAC1_SW3
.set MSG_1_viDAC8__SW4, CYREG_DAC1_SW4
.set MSG_1_viDAC8__TR, CYREG_DAC1_TR
.set MSG_1_viDAC8__TRIM__M1, CYREG_FLSHID_CUST_TABLES_DAC1_M1
.set MSG_1_viDAC8__TRIM__M2, CYREG_FLSHID_CUST_TABLES_DAC1_M2
.set MSG_1_viDAC8__TRIM__M3, CYREG_FLSHID_CUST_TABLES_DAC1_M3
.set MSG_1_viDAC8__TRIM__M4, CYREG_FLSHID_CUST_TABLES_DAC1_M4
.set MSG_1_viDAC8__TRIM__M5, CYREG_FLSHID_CUST_TABLES_DAC1_M5
.set MSG_1_viDAC8__TRIM__M6, CYREG_FLSHID_CUST_TABLES_DAC1_M6
.set MSG_1_viDAC8__TRIM__M7, CYREG_FLSHID_CUST_TABLES_DAC1_M7
.set MSG_1_viDAC8__TRIM__M8, CYREG_FLSHID_CUST_TABLES_DAC1_M8
.set MSG_1_viDAC8__TRIM__TR, CYREG_FLSHID_MFG_CFG_DAC1_TR
.set MSG_1_viDAC8__TST, CYREG_DAC1_TST

/* LCD_LCDPort */
.set LCD_LCDPort__0__MASK, 0x01
.set LCD_LCDPort__0__PC, CYREG_PRT2_PC0
.set LCD_LCDPort__0__PORT, 2
.set LCD_LCDPort__0__SHIFT, 0
.set LCD_LCDPort__1__MASK, 0x02
.set LCD_LCDPort__1__PC, CYREG_PRT2_PC1
.set LCD_LCDPort__1__PORT, 2
.set LCD_LCDPort__1__SHIFT, 1
.set LCD_LCDPort__2__MASK, 0x04
.set LCD_LCDPort__2__PC, CYREG_PRT2_PC2
.set LCD_LCDPort__2__PORT, 2
.set LCD_LCDPort__2__SHIFT, 2
.set LCD_LCDPort__3__MASK, 0x08
.set LCD_LCDPort__3__PC, CYREG_PRT2_PC3
.set LCD_LCDPort__3__PORT, 2
.set LCD_LCDPort__3__SHIFT, 3
.set LCD_LCDPort__4__MASK, 0x10
.set LCD_LCDPort__4__PC, CYREG_PRT2_PC4
.set LCD_LCDPort__4__PORT, 2
.set LCD_LCDPort__4__SHIFT, 4
.set LCD_LCDPort__5__MASK, 0x20
.set LCD_LCDPort__5__PC, CYREG_PRT2_PC5
.set LCD_LCDPort__5__PORT, 2
.set LCD_LCDPort__5__SHIFT, 5
.set LCD_LCDPort__6__MASK, 0x40
.set LCD_LCDPort__6__PC, CYREG_PRT2_PC6
.set LCD_LCDPort__6__PORT, 2
.set LCD_LCDPort__6__SHIFT, 6
.set LCD_LCDPort__AG, CYREG_PRT2_AG
.set LCD_LCDPort__AMUX, CYREG_PRT2_AMUX
.set LCD_LCDPort__BIE, CYREG_PRT2_BIE
.set LCD_LCDPort__BIT_MASK, CYREG_PRT2_BIT_MASK
.set LCD_LCDPort__BYP, CYREG_PRT2_BYP
.set LCD_LCDPort__CTL, CYREG_PRT2_CTL
.set LCD_LCDPort__DM0, CYREG_PRT2_DM0
.set LCD_LCDPort__DM1, CYREG_PRT2_DM1
.set LCD_LCDPort__DM2, CYREG_PRT2_DM2
.set LCD_LCDPort__DR, CYREG_PRT2_DR
.set LCD_LCDPort__INP_DIS, CYREG_PRT2_INP_DIS
.set LCD_LCDPort__LCD_COM_SEG, CYREG_PRT2_LCD_COM_SEG
.set LCD_LCDPort__LCD_EN, CYREG_PRT2_LCD_EN
.set LCD_LCDPort__MASK, 0x7F
.set LCD_LCDPort__PORT, 2
.set LCD_LCDPort__PRT, CYREG_PRT2_PRT
.set LCD_LCDPort__PRTDSI__CAPS_SEL, CYREG_PRT2_CAPS_SEL
.set LCD_LCDPort__PRTDSI__DBL_SYNC_IN, CYREG_PRT2_DBL_SYNC_IN
.set LCD_LCDPort__PRTDSI__OE_SEL0, CYREG_PRT2_OE_SEL0
.set LCD_LCDPort__PRTDSI__OE_SEL1, CYREG_PRT2_OE_SEL1
.set LCD_LCDPort__PRTDSI__OUT_SEL0, CYREG_PRT2_OUT_SEL0
.set LCD_LCDPort__PRTDSI__OUT_SEL1, CYREG_PRT2_OUT_SEL1
.set LCD_LCDPort__PRTDSI__SYNC_OUT, CYREG_PRT2_SYNC_OUT
.set LCD_LCDPort__PS, CYREG_PRT2_PS
.set LCD_LCDPort__SHIFT, 0
.set LCD_LCDPort__SLW, CYREG_PRT2_SLW

/* timer_clock */
.set timer_clock__CFG0, CYREG_CLKDIST_DCFG0_CFG0
.set timer_clock__CFG1, CYREG_CLKDIST_DCFG0_CFG1
.set timer_clock__CFG2, CYREG_CLKDIST_DCFG0_CFG2
.set timer_clock__CFG2_SRC_SEL_MASK, 0x07
.set timer_clock__INDEX, 0x00
.set timer_clock__PM_ACT_CFG, CYREG_PM_ACT_CFG2
.set timer_clock__PM_ACT_MSK, 0x01
.set timer_clock__PM_STBY_CFG, CYREG_PM_STBY_CFG2
.set timer_clock__PM_STBY_MSK, 0x01

/* ENT_TORQUE */
.set ENT_TORQUE__0__MASK, 0x10
.set ENT_TORQUE__0__PC, CYREG_PRT1_PC4
.set ENT_TORQUE__0__PORT, 1
.set ENT_TORQUE__0__SHIFT, 4
.set ENT_TORQUE__AG, CYREG_PRT1_AG
.set ENT_TORQUE__AMUX, CYREG_PRT1_AMUX
.set ENT_TORQUE__BIE, CYREG_PRT1_BIE
.set ENT_TORQUE__BIT_MASK, CYREG_PRT1_BIT_MASK
.set ENT_TORQUE__BYP, CYREG_PRT1_BYP
.set ENT_TORQUE__CTL, CYREG_PRT1_CTL
.set ENT_TORQUE__DM0, CYREG_PRT1_DM0
.set ENT_TORQUE__DM1, CYREG_PRT1_DM1
.set ENT_TORQUE__DM2, CYREG_PRT1_DM2
.set ENT_TORQUE__DR, CYREG_PRT1_DR
.set ENT_TORQUE__INP_DIS, CYREG_PRT1_INP_DIS
.set ENT_TORQUE__LCD_COM_SEG, CYREG_PRT1_LCD_COM_SEG
.set ENT_TORQUE__LCD_EN, CYREG_PRT1_LCD_EN
.set ENT_TORQUE__MASK, 0x10
.set ENT_TORQUE__PORT, 1
.set ENT_TORQUE__PRT, CYREG_PRT1_PRT
.set ENT_TORQUE__PRTDSI__CAPS_SEL, CYREG_PRT1_CAPS_SEL
.set ENT_TORQUE__PRTDSI__DBL_SYNC_IN, CYREG_PRT1_DBL_SYNC_IN
.set ENT_TORQUE__PRTDSI__OE_SEL0, CYREG_PRT1_OE_SEL0
.set ENT_TORQUE__PRTDSI__OE_SEL1, CYREG_PRT1_OE_SEL1
.set ENT_TORQUE__PRTDSI__OUT_SEL0, CYREG_PRT1_OUT_SEL0
.set ENT_TORQUE__PRTDSI__OUT_SEL1, CYREG_PRT1_OUT_SEL1
.set ENT_TORQUE__PRTDSI__SYNC_OUT, CYREG_PRT1_SYNC_OUT
.set ENT_TORQUE__PS, CYREG_PRT1_PS
.set ENT_TORQUE__SHIFT, 4
.set ENT_TORQUE__SLW, CYREG_PRT1_SLW

/* MAD_1_IRQ */
.set MAD_1_IRQ__INTC_CLR_EN_REG, CYREG_NVIC_CLRENA0
.set MAD_1_IRQ__INTC_CLR_PD_REG, CYREG_NVIC_CLRPEND0
.set MAD_1_IRQ__INTC_MASK, 0x01
.set MAD_1_IRQ__INTC_NUMBER, 0
.set MAD_1_IRQ__INTC_PRIOR_NUM, 7
.set MAD_1_IRQ__INTC_PRIOR_REG, CYREG_NVIC_PRI_0
.set MAD_1_IRQ__INTC_SET_EN_REG, CYREG_NVIC_SETENA0
.set MAD_1_IRQ__INTC_SET_PD_REG, CYREG_NVIC_SETPEND0

/* MAD_2_IRQ */
.set MAD_2_IRQ__INTC_CLR_EN_REG, CYREG_NVIC_CLRENA0
.set MAD_2_IRQ__INTC_CLR_PD_REG, CYREG_NVIC_CLRPEND0
.set MAD_2_IRQ__INTC_MASK, 0x02
.set MAD_2_IRQ__INTC_NUMBER, 1
.set MAD_2_IRQ__INTC_PRIOR_NUM, 7
.set MAD_2_IRQ__INTC_PRIOR_REG, CYREG_NVIC_PRI_1
.set MAD_2_IRQ__INTC_SET_EN_REG, CYREG_NVIC_SETENA0
.set MAD_2_IRQ__INTC_SET_PD_REG, CYREG_NVIC_SETPEND0

/* SAIDA_VEL */
.set SAIDA_VEL__0__MASK, 0x40
.set SAIDA_VEL__0__PC, CYREG_PRT1_PC6
.set SAIDA_VEL__0__PORT, 1
.set SAIDA_VEL__0__SHIFT, 6
.set SAIDA_VEL__AG, CYREG_PRT1_AG
.set SAIDA_VEL__AMUX, CYREG_PRT1_AMUX
.set SAIDA_VEL__BIE, CYREG_PRT1_BIE
.set SAIDA_VEL__BIT_MASK, CYREG_PRT1_BIT_MASK
.set SAIDA_VEL__BYP, CYREG_PRT1_BYP
.set SAIDA_VEL__CTL, CYREG_PRT1_CTL
.set SAIDA_VEL__DM0, CYREG_PRT1_DM0
.set SAIDA_VEL__DM1, CYREG_PRT1_DM1
.set SAIDA_VEL__DM2, CYREG_PRT1_DM2
.set SAIDA_VEL__DR, CYREG_PRT1_DR
.set SAIDA_VEL__INP_DIS, CYREG_PRT1_INP_DIS
.set SAIDA_VEL__LCD_COM_SEG, CYREG_PRT1_LCD_COM_SEG
.set SAIDA_VEL__LCD_EN, CYREG_PRT1_LCD_EN
.set SAIDA_VEL__MASK, 0x40
.set SAIDA_VEL__PORT, 1
.set SAIDA_VEL__PRT, CYREG_PRT1_PRT
.set SAIDA_VEL__PRTDSI__CAPS_SEL, CYREG_PRT1_CAPS_SEL
.set SAIDA_VEL__PRTDSI__DBL_SYNC_IN, CYREG_PRT1_DBL_SYNC_IN
.set SAIDA_VEL__PRTDSI__OE_SEL0, CYREG_PRT1_OE_SEL0
.set SAIDA_VEL__PRTDSI__OE_SEL1, CYREG_PRT1_OE_SEL1
.set SAIDA_VEL__PRTDSI__OUT_SEL0, CYREG_PRT1_OUT_SEL0
.set SAIDA_VEL__PRTDSI__OUT_SEL1, CYREG_PRT1_OUT_SEL1
.set SAIDA_VEL__PRTDSI__SYNC_OUT, CYREG_PRT1_SYNC_OUT
.set SAIDA_VEL__PS, CYREG_PRT1_PS
.set SAIDA_VEL__SHIFT, 6
.set SAIDA_VEL__SLW, CYREG_PRT1_SLW

/* ENT_ALFA */
.set ENT_ALFA__0__MASK, 0x04
.set ENT_ALFA__0__PC, CYREG_PRT1_PC2
.set ENT_ALFA__0__PORT, 1
.set ENT_ALFA__0__SHIFT, 2
.set ENT_ALFA__AG, CYREG_PRT1_AG
.set ENT_ALFA__AMUX, CYREG_PRT1_AMUX
.set ENT_ALFA__BIE, CYREG_PRT1_BIE
.set ENT_ALFA__BIT_MASK, CYREG_PRT1_BIT_MASK
.set ENT_ALFA__BYP, CYREG_PRT1_BYP
.set ENT_ALFA__CTL, CYREG_PRT1_CTL
.set ENT_ALFA__DM0, CYREG_PRT1_DM0
.set ENT_ALFA__DM1, CYREG_PRT1_DM1
.set ENT_ALFA__DM2, CYREG_PRT1_DM2
.set ENT_ALFA__DR, CYREG_PRT1_DR
.set ENT_ALFA__INP_DIS, CYREG_PRT1_INP_DIS
.set ENT_ALFA__LCD_COM_SEG, CYREG_PRT1_LCD_COM_SEG
.set ENT_ALFA__LCD_EN, CYREG_PRT1_LCD_EN
.set ENT_ALFA__MASK, 0x04
.set ENT_ALFA__PORT, 1
.set ENT_ALFA__PRT, CYREG_PRT1_PRT
.set ENT_ALFA__PRTDSI__CAPS_SEL, CYREG_PRT1_CAPS_SEL
.set ENT_ALFA__PRTDSI__DBL_SYNC_IN, CYREG_PRT1_DBL_SYNC_IN
.set ENT_ALFA__PRTDSI__OE_SEL0, CYREG_PRT1_OE_SEL0
.set ENT_ALFA__PRTDSI__OE_SEL1, CYREG_PRT1_OE_SEL1
.set ENT_ALFA__PRTDSI__OUT_SEL0, CYREG_PRT1_OUT_SEL0
.set ENT_ALFA__PRTDSI__OUT_SEL1, CYREG_PRT1_OUT_SEL1
.set ENT_ALFA__PRTDSI__SYNC_OUT, CYREG_PRT1_SYNC_OUT
.set ENT_ALFA__PS, CYREG_PRT1_PS
.set ENT_ALFA__SHIFT, 2
.set ENT_ALFA__SLW, CYREG_PRT1_SLW

/* isr_1 */
.set isr_1__INTC_CLR_EN_REG, CYREG_NVIC_CLRENA0
.set isr_1__INTC_CLR_PD_REG, CYREG_NVIC_CLRPEND0
.set isr_1__INTC_MASK, 0x04
.set isr_1__INTC_NUMBER, 2
.set isr_1__INTC_PRIOR_NUM, 7
.set isr_1__INTC_PRIOR_REG, CYREG_NVIC_PRI_2
.set isr_1__INTC_SET_EN_REG, CYREG_NVIC_SETENA0
.set isr_1__INTC_SET_PD_REG, CYREG_NVIC_SETPEND0

/* Miscellaneous */
/* -- WARNING: define names containing LEOPARD or PANTHER are deprecated and will be removed in a future release */
.set CYDEV_DEBUGGING_DPS_SWD_SWV, 6
.set CYDEV_CONFIG_UNUSED_IO_AllowButWarn, 0
.set CYDEV_CONFIGURATION_MODE_COMPRESSED, 0
.set CYDEV_CONFIG_FASTBOOT_ENABLED, 0
.set CYDEV_CHIP_REV_PANTHER_PRODUCTION, 1
.set CYDEV_CHIP_REVISION_5A_PRODUCTION, 1
.set CYDEV_CHIP_MEMBER_5A, 3
.set CYDEV_CHIP_FAMILY_PSOC5, 3
.set CYDEV_CHIP_DIE_PANTHER, 3
.set CYDEV_CHIP_DIE_EXPECT, CYDEV_CHIP_DIE_PANTHER
.set BCLK__BUS_CLK__HZ, 24000000
.set BCLK__BUS_CLK__KHZ, 24000
.set BCLK__BUS_CLK__MHZ, 24
.set CYDEV_CHIP_DIE_ACTUAL, CYDEV_CHIP_DIE_EXPECT
.set CYDEV_CHIP_DIE_LEOPARD, 1
.set CYDEV_CHIP_DIE_PSOC4A, 2
.set CYDEV_CHIP_DIE_PSOC5LP, 4
.set CYDEV_CHIP_DIE_UNKNOWN, 0
.set CYDEV_CHIP_FAMILY_PSOC3, 1
.set CYDEV_CHIP_FAMILY_PSOC4, 2
.set CYDEV_CHIP_FAMILY_UNKNOWN, 0
.set CYDEV_CHIP_FAMILY_USED, CYDEV_CHIP_FAMILY_PSOC5
.set CYDEV_CHIP_JTAG_ID, 0x0E13C069
.set CYDEV_CHIP_MEMBER_3A, 1
.set CYDEV_CHIP_MEMBER_4A, 2
.set CYDEV_CHIP_MEMBER_5B, 4
.set CYDEV_CHIP_MEMBER_UNKNOWN, 0
.set CYDEV_CHIP_MEMBER_USED, CYDEV_CHIP_MEMBER_5A
.set CYDEV_CHIP_REVISION_3A_ES1, 0
.set CYDEV_CHIP_REVISION_3A_ES2, 1
.set CYDEV_CHIP_REVISION_3A_ES3, 3
.set CYDEV_CHIP_REVISION_3A_PRODUCTION, 3
.set CYDEV_CHIP_REVISION_4A_ES0, 17
.set CYDEV_CHIP_REVISION_4A_PRODUCTION, 17
.set CYDEV_CHIP_REVISION_5A_ES0, 0
.set CYDEV_CHIP_REVISION_5A_ES1, 1
.set CYDEV_CHIP_REVISION_5B_ES0, 0
.set CYDEV_CHIP_REVISION_5B_PRODUCTION, 0
.set CYDEV_CHIP_REVISION_USED, CYDEV_CHIP_REVISION_5A_PRODUCTION
.set CYDEV_CHIP_REV_EXPECT, CYDEV_CHIP_REV_PANTHER_PRODUCTION
.set CYDEV_CHIP_REV_LEOPARD_ES1, 0
.set CYDEV_CHIP_REV_LEOPARD_ES2, 1
.set CYDEV_CHIP_REV_LEOPARD_ES3, 3
.set CYDEV_CHIP_REV_LEOPARD_PRODUCTION, 3
.set CYDEV_CHIP_REV_PANTHER_ES0, 0
.set CYDEV_CHIP_REV_PANTHER_ES1, 1
.set CYDEV_CHIP_REV_PSOC4A_ES0, 17
.set CYDEV_CHIP_REV_PSOC4A_PRODUCTION, 17
.set CYDEV_CHIP_REV_PSOC5LP_ES0, 0
.set CYDEV_CHIP_REV_PSOC5LP_PRODUCTION, 0
.set CYDEV_CONFIGURATION_COMPRESSED, 1
.set CYDEV_CONFIGURATION_DMA, 0
.set CYDEV_CONFIGURATION_ECC, 1
.set CYDEV_CONFIGURATION_IMOENABLED, CYDEV_CONFIG_FASTBOOT_ENABLED
.set CYDEV_CONFIGURATION_MODE, CYDEV_CONFIGURATION_MODE_COMPRESSED
.set CYDEV_CONFIGURATION_MODE_DMA, 2
.set CYDEV_CONFIGURATION_MODE_UNCOMPRESSED, 1
.set CYDEV_CONFIG_UNUSED_IO, CYDEV_CONFIG_UNUSED_IO_AllowButWarn
.set CYDEV_CONFIG_UNUSED_IO_AllowWithInfo, 1
.set CYDEV_CONFIG_UNUSED_IO_Disallowed, 2
.set CYDEV_DATA_CACHE_ENABLED, 0
.set CYDEV_DEBUGGING_DPS, CYDEV_DEBUGGING_DPS_SWD_SWV
.set CYDEV_DEBUGGING_DPS_Disable, 3
.set CYDEV_DEBUGGING_ENABLE, 1
.set CYDEV_DEBUGGING_REQXRES, 1
.set CYDEV_DEBUGGING_XRES, 0
.set CYDEV_DEBUG_ENABLE_MASK, 0x01
.set CYDEV_DEBUG_ENABLE_REGISTER, CYREG_MLOGIC_DBG_DBE
.set CYDEV_DMA_CHANNELS_AVAILABLE, 24
.set CYDEV_ECC_ENABLE, 0
.set CYDEV_HEAP_SIZE, 0x1000
.set CYDEV_INSTRUCT_CACHE_ENABLED, 1
.set CYDEV_INTR_RISING, 0x00000003
.set CYDEV_PROJ_TYPE, 0
.set CYDEV_PROJ_TYPE_BOOTLOADER, 1
.set CYDEV_PROJ_TYPE_LOADABLE, 2
.set CYDEV_PROJ_TYPE_MULTIAPPBOOTLOADER, 3
.set CYDEV_PROJ_TYPE_STANDARD, 0
.set CYDEV_PROTECTION_ENABLE, 0
.set CYDEV_STACK_SIZE, 0x4000
.set CYDEV_USE_BUNDLED_CMSIS, 1
.set CYDEV_VDDA_MV, 5000
.set CYDEV_VDDD_MV, 5000
.set CYDEV_VDDIO0_MV, 5000
.set CYDEV_VDDIO1_MV, 5000
.set CYDEV_VDDIO2_MV, 5000
.set CYDEV_VDDIO3_MV, 5000
.set CYDEV_VIO0, 5
.set CYDEV_VIO0_MV, 5000
.set CYDEV_VIO1, 5
.set CYDEV_VIO1_MV, 5000
.set CYDEV_VIO2, 5
.set CYDEV_VIO2_MV, 5000
.set CYDEV_VIO3, 5
.set CYDEV_VIO3_MV, 5000
.set DMA_CHANNELS_USED__MASK0, 0x00000000
.set CYDEV_BOOTLOADER_ENABLE, 0
.endif
